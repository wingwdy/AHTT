#include "modbus.h"
#include <string.h>

#include "FreeRTOS.h"
#include "task.h"
#include "cmsis_os2.h"

/* Table of CRC values for high–order byte */
static const uint8_t auchCRCHi[] =
{
0x00, 0xC1, 0x81, 0x40, 0x01, 0xC0, 0x80, 0x41, 0x01, 0xC0, 0x80, 0x41, 0x00, 0xC1, 0x81,
0x40, 0x01, 0xC0, 0x80, 0x41, 0x00, 0xC1, 0x81, 0x40, 0x00, 0xC1, 0x81, 0x40, 0x01, 0xC0,
0x80, 0x41, 0x01, 0xC0, 0x80, 0x41, 0x00, 0xC1, 0x81, 0x40, 0x00, 0xC1, 0x81, 0x40, 0x01,
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0x00, 0xC1, 0x81, 0x40, 0x01, 0xC0, 0x80, 0x41, 0x01, 0xC0, 0x80, 0x41, 0x00, 0xC1, 0x81,
0x40
} ;

/* Table of CRC values for low–order byte */
static const uint8_t auchCRCLo[] =
{
0x00, 0xC0, 0xC1, 0x01, 0xC3, 0x03, 0x02, 0xC2, 0xC6, 0x06, 0x07, 0xC7, 0x05, 0xC5, 0xC4,
0x04, 0xCC, 0x0C, 0x0D, 0xCD, 0x0F, 0xCF, 0xCE, 0x0E, 0x0A, 0xCA, 0xCB, 0x0B, 0xC9, 0x09,
0x08, 0xC8, 0xD8, 0x18, 0x19, 0xD9, 0x1B, 0xDB, 0xDA, 0x1A, 0x1E, 0xDE, 0xDF, 0x1F, 0xDD,
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0x44, 0x84, 0x85, 0x45, 0x87, 0x47, 0x46, 0x86, 0x82, 0x42, 0x43, 0x83, 0x41, 0x81, 0x80,
0x40
} ;
/*------------------------------------------------------------------------------*/
/* CRC16                                                                        */
/* puchMsg:  message to calculate CRC upon                                      */
/* usDataLen:  quantity of bytes in message                                     */
/*------------------------------------------------------------------------------*/
uint16_t CRC16(uint8_t *puchMsg, uint16_t usDataLen)
{
    uint8_t   uchCRCHi = 0xFF;                            /* high byte of CRC initialized */
    uint8_t   uchCRCLo = 0xFF;                            /* low byte of CRC initialized */
    uint8_t   uIndex;                                     /* will index into CRC lookup table */

    while(usDataLen--)                                  /* pass through message buffer */
    {
        uIndex = uchCRCHi ^ *puchMsg++;                 /* calculate the CRC */
        uchCRCHi = uchCRCLo ^ auchCRCHi[uIndex];
        uchCRCLo = auchCRCLo[uIndex];
    }
    return  (uchCRCHi << 8) | uchCRCLo;
}


uint16_t ModbusCRC(uint8_t *pData, uint32_t len)
{
    int crc = 0x0000ffff;
    int POLYNOMIAL = 0x0000a001;
    int i, j;
	
    for (i = 0; i < len; i++) {
        crc ^= ((int) pData[i] & 0x000000ff);
        for (j = 0; j < 8; j++) {
        	if ((crc & 0x00000001) != 0) {
            	crc >>= 1;
            	crc ^= POLYNOMIAL;
        	} else {
            	crc >>= 1;
        	}
        }
    }
    return crc;
}

//接收数据整理
uint8_t Modbus_Recv_CrcCheck(uint8_t *buf, uint16_t len)
{
  ModbusFrame *f = (ModbusFrame *) buf;
  uint8_t   *bp = &f->dev;

    uint16_t crc = (bp[len - 2] << 8) + bp[len - 1];
    uint16_t calc = CRC16 (bp, len - 2);
    if(crc != calc)
    {
      printf("crc != calc  0x%x  0x%x\r\n", crc, calc);
      return 0;
    }
    return 1;
}

ModbusFrame *MbsComm_ParsePack(STRU_MBUS_COMM_CONTEXT *g_pstuMbsCommHandle)
{
	E_UART_ERR e_UartErr = E_UART_NO_ERR;
	uint8_t*	pData = 0;//数据地址
	uint16_t	uLen = 0;//数据长度
	uint16_t	uPackLen = 0;//报文长度
	g_pstuMbsCommHandle->m_uRcvLen = 0;
	uLen = fgu16_UartRecvRoute(g_pstuMbsCommHandle->e_UartChnId, g_pstuMbsCommHandle->m_aucRcvBuf + g_pstuMbsCommHandle->m_uRcvLen, sizeof(g_pstuMbsCommHandle->m_aucRcvBuf) - g_pstuMbsCommHandle->m_uRcvLen, &e_UartErr);
	while(uLen)
	{
		g_pstuMbsCommHandle->m_uRcvLen += uLen;
		osDelay(1);
		uLen = fgu16_UartRecvRoute(g_pstuMbsCommHandle->e_UartChnId, g_pstuMbsCommHandle->m_aucRcvBuf + g_pstuMbsCommHandle->m_uRcvLen, sizeof(g_pstuMbsCommHandle->m_aucRcvBuf) - g_pstuMbsCommHandle->m_uRcvLen, &e_UartErr);
	}
	if(g_pstuMbsCommHandle->m_uRcvLen == 0 || uLen != 0)//当前接收缓存无数据，或数据帧接收未完毕
	{
		return NULL;
	}
  if (!Modbus_Recv_CrcCheck(g_pstuMbsCommHandle->m_aucRcvBuf, g_pstuMbsCommHandle->m_uRcvLen)) {  
		return NULL;
  }
  ModbusFrame *f = (ModbusFrame *)g_pstuMbsCommHandle->m_aucRcvBuf;

  fge_UartClearRxBufRoute(g_pstuMbsCommHandle->e_UartChnId);
  g_pstuMbsCommHandle->m_uRcvLen = 0;

	return f;
}

int32_t MbsComm_SendPack(STRU_MBUS_COMM_CONTEXT *g_pstuMbsCommHandle, uint8_t *p_data, uint16_t len)
{
  int32_t res = 0;
  E_UART_ERR e_UartErr;
	uint8_t   *bp = p_data;

	/* 计算CRC */
	uint16_t  crc;
	crc = CRC16 (p_data, len);

	bp[len++] = crc >> 8;
	bp[len++] = crc & 0xFF;

  e_UartErr = fge_CCU_UartDMASendRoute((uint8_t *)p_data, len);

  return res;
}


void MbsCommModuleInit(STRU_MBUS_COMM_CONTEXT *g_pstuMbsCommHandle, E_UART_CHANNEL_LIST channel)
{
    g_pstuMbsCommHandle->e_UartChnId = channel;
}
